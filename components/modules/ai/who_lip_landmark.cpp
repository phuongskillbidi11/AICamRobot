#include "who_lip_landmark.hpp"

#include "esp_heap_caps.h"
#include "esp_log.h"
#include <math.h>
#include <string.h>

static const char *TAG = "lip_landmark";

#define CROP_SZ 48  /* model input: 48×48 grayscale */

LipLandmark6Pt::LipLandmark6Pt()
    : m_loaded(false), m_crop_buf(nullptr)
{
    m_crop_buf = (uint8_t *)heap_caps_malloc(CROP_SZ * CROP_SZ,
                                              MALLOC_CAP_SPIRAM | MALLOC_CAP_8BIT);
    if (!m_crop_buf)
        m_crop_buf = (uint8_t *)malloc(CROP_SZ * CROP_SZ);

    if (!m_crop_buf) {
        ESP_LOGE(TAG, "Crop buffer alloc failed");
        return;
    }

#ifdef LIP_MODEL_AVAILABLE
    /* Model initialisation goes here once weights are generated.
       Set m_loaded = true after successful load. */
    m_loaded = true;
    ESP_LOGI(TAG, "Lip landmark model loaded");
#else
    ESP_LOGW(TAG, "LIP_MODEL_AVAILABLE not defined — stub mode (returns -1)");
#endif
}

LipLandmark6Pt::~LipLandmark6Pt()
{
    if (m_crop_buf) {
        heap_caps_free(m_crop_buf);
        m_crop_buf = nullptr;
    }
}

/* Bilinear sample: RGB565 to uint8 luminance at fractional pixel (fx, fy).
   Defined only when model is active to avoid unused-function warning. */
#ifdef LIP_MODEL_AVAILABLE
static uint8_t sample_grey_bilinear(const uint16_t *buf, int img_w, int img_h,
                                     float fx, float fy)
{
    int x0 = (int)fx, y0 = (int)fy;
    int x1 = x0 + 1,  y1 = y0 + 1;
    if (x0 < 0)       x0 = 0;
    if (x0 >= img_w)  x0 = img_w - 1;
    if (x1 < 0)       x1 = 0;
    if (x1 >= img_w)  x1 = img_w - 1;
    if (y0 < 0)       y0 = 0;
    if (y0 >= img_h)  y0 = img_h - 1;
    if (y1 < 0)       y1 = 0;
    if (y1 >= img_h)  y1 = img_h - 1;

    float wx = fx - (float)x0;
    float wy = fy - (float)y0;

    /* Rec.601 luminance from RGB565 components. */
    auto lum = [&](int x, int y) -> float {
        uint16_t px = buf[y * img_w + x];
        float r = (float)((px >> 11) & 0x1F) * (255.0f / 31.0f);
        float g = (float)((px >>  5) & 0x3F) * (255.0f / 63.0f);
        float b = (float)( px        & 0x1F) * (255.0f / 31.0f);
        return 0.299f * r + 0.587f * g + 0.114f * b;
    };

    float v = lum(x0, y0) * (1.0f - wx) * (1.0f - wy)
            + lum(x1, y0) *        wx  * (1.0f - wy)
            + lum(x0, y1) * (1.0f - wx) *        wy
            + lum(x1, y1) *        wx  *        wy;

    return (uint8_t)(v + 0.5f);
}
#endif /* LIP_MODEL_AVAILABLE */

float LipLandmark6Pt::infer(const camera_fb_t *frame,
                             const dl::detect::result_t &face)
{
    /* Without trained weights every path returns -1 so the caller falls
       through to Phase-2a pixel MAR. */
#ifndef LIP_MODEL_AVAILABLE
    (void)frame; (void)face;
    return -1.0f;
#else
    if (!m_loaded || !m_crop_buf) return -1.0f;
    if (!frame || frame->format != PIXFORMAT_RGB565 || !frame->buf) return -1.0f;
    if (face.keypoint.size() < 10) return -1.0f;

    const uint16_t *buf = (const uint16_t *)frame->buf;
    int img_w = (int)frame->width;
    int img_h = (int)frame->height;

    /* Derive mouth crop from detection keypoints.
       keypoint layout (MNP01): [0,1]=le [2,3]=ml [4,5]=nose [6,7]=re [8,9]=mr */
    float ml_x = (float)face.keypoint[2], ml_y = (float)face.keypoint[3];
    float mr_x = (float)face.keypoint[8], mr_y = (float)face.keypoint[9];
    float mw = mr_x - ml_x;
    if (mw < 4.0f) return -1.0f;

    float cx = (ml_x + mr_x) * 0.5f;
    float cy = (ml_y + mr_y) * 0.5f;
    float half_w = mw * 1.10f;   /* slightly wider than mouth corners */
    float half_h = mw * 0.70f;

    /* Bilinear resize ROI → CROP_SZ×CROP_SZ scratch buffer. */
    for (int dy = 0; dy < CROP_SZ; dy++) {
        float fy = cy - half_h + (2.0f * half_h / CROP_SZ) * (dy + 0.5f);
        for (int dx = 0; dx < CROP_SZ; dx++) {
            float fx = cx - half_w + (2.0f * half_w / CROP_SZ) * (dx + 0.5f);
            m_crop_buf[dy * CROP_SZ + dx] =
                sample_grey_bilinear(buf, img_w, img_h, fx, fy);
        }
    }

    /* ── Model inference placeholder ─────────────────────────────────────
       Replace the block below with real esp-dl model invocation once the
       quantised weights are generated by:
         python train_lip_model.py --wflw_root /data/WFLW --output lip_landmark_6pt.onnx
         python optimizer.py --input lip_landmark_6pt.onnx --output lip_quant/
         python convert.py --cfg lip_quant/config.json --output lip_model_esp.cpp

       float outputs[12];
       lip_model_esp_infer(m_crop_buf, CROP_SZ, CROP_SZ, outputs);

       // true_mar = inner vertical gap / outer horizontal width
       float inner_dy = fabsf(outputs[9]  - outputs[11]);
       float outer_dx = fabsf(outputs[2]  - outputs[0]);
       if (outer_dx < 0.01f) return -1.0f;
       return inner_dy / outer_dx;
    ─────────────────────────────────────────────────────────────────────── */

    return -1.0f;  /* remove when model weights are wired up */
#endif
}
